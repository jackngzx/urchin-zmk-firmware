## boards/Kconfig.shield
```kconfig
config SHIELD_URCHIN_DONGLE
    def_bool $(shields_list_contains,URCHIN_DONGLE)

config SHIELD_URCHIN_LEFT
    def_bool $(shields_list_contains,URCHIN_LEFT)

config SHIELD_URCHIN_RIGHT
    def_bool $(shields_list_contains,URCHIN_RIGHT)

config SHIELD_URCHIN_LEFT_PERIPHERAL
    def_bool $(shields_list_contains,URCHIN_LEFT_peripheral)

# This sets the role automatically based on the shield name
config ZMK_SPLIT_BLE_ROLE_CENTRAL
    default y if SHIELD_URCHIN_LEFT || SHIELD_URCHIN_DONGLE
    default n if SHIELD_URCHIN_LEFT_PERIPHERAL || SHIELD_URCHIN_RIGHT
```

## boards/shields/urchin/Kconfig.defconfig
```kconfig
# Copyright (c) 2025 The ZMK Contributors
# SPDX-License-Identifier: MIT

# --- COMMON SETTINGS ---
if SHIELD_URCHIN_DONGLE || SHIELD_URCHIN_LEFT || SHIELD_URCHIN_LEFT_PERIPHERAL || SHIELD_URCHIN_RIGHT || SHIELD_URCHIN_RIGHT_PERIPHERAL
    config ZMK_KEYBOARD_NAME
        default "URCHIN"

    config ZMK_SPLIT
        default y
endif

# --- DONGLE ROLE (Central) ---
if SHIELD_URCHIN_DONGLE
    config ZMK_SPLIT_BLE_ROLE_CENTRAL
        default y
    config ZMK_SPLIT_BLE_CENTRAL_PERIPHERALS
        default 2
    config BT_MAX_CONN
        default 6
    config BT_MAX_PAIRED
        default 6
    config ZMK_USB
        default y
endif

# --- LEFT SIDE ROLE (Central in standard, Peripheral in dongle) ---
if SHIELD_URCHIN_LEFT
    config ZMK_SPLIT_BLE_ROLE_CENTRAL
        default y
endif

if SHIELD_URCHIN_LEFT_PERIPHERAL
    config ZMK_SPLIT_BLE_ROLE_CENTRAL
        default n
endif

# --- RIGHT SIDE ROLE (Always Peripheral) ---
if SHIELD_URCHIN_RIGHT || SHIELD_URCHIN_RIGHT_PERIPHERAL
    config ZMK_SPLIT_BLE_ROLE_CENTRAL
        default n
endif
```

## boards/shields/urchin/Kconfig.shield
```kconfig
config SHIELD_URCHIN_DONGLE
    def_bool $(shields_list_contains,urchin_dongle)

config SHIELD_URCHIN_LEFT
    def_bool $(shields_list_contains,urchin_left)

config SHIELD_URCHIN_RIGHT
    def_bool $(shields_list_contains,urchin_right)

config SHIELD_URCHIN_LEFT_PERIPHERAL
    def_bool $(shields_list_contains,urchin_left_peripheral)

# This sets the role automatically based on the shield name
config ZMK_SPLIT_BLE_ROLE_CENTRAL
    default y if SHIELD_URCHIN_LEFT || SHIELD_URCHIN_DONGLE
    default n if SHIELD_URCHIN_LEFT_PERIPHERAL || SHIELD_URCHIN_RIGHT
```

## config/west.yml
```yaml
manifest:
  remotes:
    # zmk official
    - name: zmkfirmware
      url-base: https://github.com/zmkfirmware
      # bravekarma
    - name: caksoylar
      url-base: https://github.com/caksoylar
      # kyek / duckyb
    - name: duckyb
      url-base: https://github.com/duckyb
      # hammerbeam
    - name: gpeye 
      url-base: https://github.com/GPeye 
  projects:
    - name: zmk
      remote: zmkfirmware
      revision: main
      import: app/west.yml
    - name: urchin-zmk-module
      remote: duckyb
      revision: main
    - name: hammerbeam-slideshow #new entry
      remote: gpeye #new entry
      revision: main
  self:
    path: config
```
